## Kconfig
```kconfig
# Bosch Application Board 3.0 board configuration

# Copyright (c) 2024 Dr. Konstantin Selyunin
# SPDX-License-Identifier: Apache-2.0

config BOARD_ENABLE_DCDC
	bool "DCDC mode"
	select SOC_DCDC_NRF52X
	default y
	depends on BOARD_BOSCH_APPLICATION_BOARD_3_0
```

## Kconfig.board
```kconfig
# Bosch Application Board 3.0 board configuration

# Copyright (c) 2024 Dr. Konstantin Selyunin
# SPDX-License-Identifier: Apache-2.0

config BOARD_BOSCH_APPLICATION_BOARD_3_0
	bool "Bosch APP-BOARD-3.0"
	depends on SOC_NRF52840_QIAA
```

## Kconfig.defconfig
```kconfig
# Bosch Application Board 3.0 board configuration

# Copyright (c) 2024 Dr. Konstantin Selyunin
# SPDX-License-Identifier: Apache-2.0

if BOARD_BOSCH_APPLICATION_BOARD_3_0

config BOARD_ENABLE_DCDC
	bool "DCDC mode"
	select SOC_DCDC_NRF52X
	default y
	depends on BOARD_BOSCH_APPLICATION_BOARD_3_0

config BOARD_SERIAL_BACKEND_CDC_ACM
	bool "USB CDC"
	default y

endif # BOARD_BOSCH_APPLICATION_BOARD_3_0

if BOARD_UBX_EVKNINAB3_NRF52840

config BOARD
	default "ubx_evkninab3_nrf52840"

if BOARD_SERIAL_BACKEND_CDC_ACM

config USB_DEVICE_STACK
	default y

config USB_CDC_ACM
	default SERIAL

config CONSOLE
	default y

config UART_CONSOLE
	default CONSOLE

config USB_DEVICE_INITIALIZE_AT_BOOT
	default y if !MCUBOOT && CONSOLE

config SHELL_BACKEND_SERIAL_CHECK_DTR
	default SHELL
	depends on UART_LINE_CTRL

config UART_LINE_CTRL
	default SHELL

config USB_DEVICE_REMOTE_WAKEUP
	default n

if LOG

# Logger cannot use itself to log
choice USB_CDC_ACM_LOG_LEVEL_CHOICE
	default USB_CDC_ACM_LOG_LEVEL_OFF
endchoice

# Set USB log level to error only
choice USB_DEVICE_LOG_LEVEL_CHOICE
	default USB_DEVICE_LOG_LEVEL_ERR
endchoice

# Wait 4000ms at startup for logging
config LOG_PROCESS_THREAD_STARTUP_DELAY_MS
	default 4000

endif # LOG

if USB_DEVICE_STACK

# Enable UART driver, needed for CDC ACM
config SERIAL
	default y

endif # USB_DEVICE_STACK

endif # BOARD_SERIAL_BACKEND_CDC_ACM

config BT_CTLR
	default BT

endif # BOARD_UBX_EVKNINAB3_NRF52840
```

## board.yml
```yaml
board:
  name: bosch_application_board_3_0
  full_name: Application Board 3.0
  vendor: nordic
  socs:
    - name: nrf52840
```

## boards/bosch/application_board_3_0/Kconfig.bosch_application_board_3_0
```kconfig
# Bosch Application Board 3.0 configuration

# Copyright (c) 2025 Dr. Konstantin Selyunin
# SPDX-License-Identifier: Apache-2.0

config BOARD_BOSCH_APPLICATION_BOARD_3_0
	select SOC_NRF52840_QIAA
```

## boards/bosch/application_board_3_0/board.yml
```yaml
board:
  name: bosch_application_board_3_0
  full_name: Application Board 3.0
  vendor: bosch
  socs:
    - name: nrf52840
```

## boards/bosch/application_board_3_1/Kconfig.bosch_application_board_3_1
```kconfig
# Bosch Application Board 3.1 board configuration

# Copyright (c) 2025 Dr. Konstantin Selyunin
# SPDX-License-Identifier: Apache-2.0

config BOARD_BOSCH_APPLICATION_BOARD_3_1
	select SOC_NRF52840_QIAA
```

## boards/bosch/application_board_3_1/board.yml
```yaml
board:
  name: bosch_application_board_3_1
  full_name: Application Board 3.1
  vendor: bosch
  socs:
    - name: nrf52840
```

## bosch_application_board_3_0_defconfig
```kconfig
# EVK-NINA-B3 board configuration

# Copyright (c) 2024 Dr. Konstantin Selyunin
# SPDX-License-Identifier: Apache-2.0

CONFIG_SOC_SERIES_NRF52X=y
CONFIG_SOC_NRF52840_QIAA=y
CONFIG_BOARD_BOSCH_APPLICATION_BOARD_3_0=y

# Enable MPU
CONFIG_ARM_MPU=y

# Enable hardware stack protection
CONFIG_HW_STACK_PROTECTION=y

# Enable RTT
CONFIG_CONSOLE=y
CONFIG_USE_SEGGER_RTT=y

# enable GPIO
CONFIG_GPIO=y
```

## dts/bindings/power-switches.yaml
```yaml
# Copyright (c) 2024, Dr. Konstantin Selyunin
# SPDX-License-Identifier: Apache-2.0

description: |
  This allows you to define a group of power switches. 
  Each power switch in the group is controlled by a GPIO. 
  Each power switch is defined in a child node of the power-switches node.

  Here is an example which defines two power switches in the node /power-switches:

  / {
  	power_switches {
  		compatible = "gpio-power-switches";
  		power_switch_1V8 {
  			gpios = <&gpio0 1 GPIO_ACTIVE_HIGH>;
  		};
  		power_switch_3V3 {
  			gpios = <&gpio0 2 GPIO_ACTIVE_HIGH>;
  		};
  	};
  };

  Above:

  - power_switch_1V8 is pin 1 on gpio0. The 1.8V power is on when the pin is high,
    and off when the pin is low.
  - power_switch_3V3 is pin 2 on gpio0. The 3.3V power is on when the pin is high,
    and off when it is low.

compatible: "gpio-power-switches"

child-binding:
  description: GPIO power switch child node
  properties:
    gpios:
      type: phandle-array
      required: true
    label:
      type: string
      description: |
        Human readable string describing the power switch. It can be used by an
        application to identify the power switch or to retrieve its number/index
        (i.e. child node number) on the parent device.
```
